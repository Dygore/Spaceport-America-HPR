[appendix]
== Technical Information

	=== GPS Receiver
      
		TeleGPS uses the u-Blox Max-7Q GPS receiver.
      
	=== 70cm Transmitter

		TeleGPS uses a TI CC115L transmitter. This radio
		produces 10mW of RF output.

	=== Micro-controller
      
		TeleGPS uses an NXP LPC11U14 micro-controller. This
		tiny CPU contains 32kB of flash for the application
		and 4kB of RAM for temporary data storage.

	=== Lithium Polymer Battery
      
		Shipping restrictions may prevent us from including a
		battery battery with TeleGPS.
      
	=== Mechanical Considerations
      
		TeleGPS is designed to be rugged enough for typical
		rocketry applications.  The 4 mounting holes on the
		board are sized for use with 4-40 or M3 screws.

	=== On-board data storage
      
		TeleGPS has 2MB of non-volatile storage, separate from
		the code storage memory. The TeleGPS firmware uses
		this to log information during flight.
