== Specifications

	The TeleLaunch system can handle up to 99 banks with each bank
	having up to 8 pads, for a total of 792 pads.

	Each unit in the TeleLaunch system is water-resistant, but is not
	intended to be directly immersed in water.  Brief rain showers during
	a launch should pose no problem, but it's recommended to cover units
	or bring them inside when not in use or during extended periods of 
	bad weather.

	TeleLCO uses an internal single-cell 2Ah Lithium Polymer battery,
	which is sufficient for multiple days of typical operation.  This
	battery is charged over USB.

	TeleFire uses an internal sealed lead-acid 12V battery, which is
	charged by an external charger attached through the PowerPole
	connector on the rear panel.

	Pyro initiation uses the 12V sealed lead-acid battery.  Current
	to any pad can exceed 30A, and with typical igniters every pad on
	a TeleFire can be successfully included in a drag race.  The system
	controls current flow to prevent damage, and has a self-resetting 
	circuit breaker for ultimate protection should something go badly 
	wrong.

	TeleLaunch uses AES encryption with a shared key between each unit
	in the system to ensure the integrity of safe launch operations.

	The TeleLaunch system uses radio frequency communications in the
	vicinity of 435 Mhz.  A US amateur radio license or equivalent
	authorization is required to legally use the system.  The operating
	frequency should be chosen to avoid conflict with other devices, or
	put differently, nothing else should be operating on the same 
	frequency while TeleLaunch is in use.

