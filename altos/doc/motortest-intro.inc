== Introduction and Overview

Welcome to the Altus Metrum community! Our circuits and software reflect
our passion for both hobby rocketry and Free Software. We hope their
capabilities and performance will delight you in every way, but by
releasing all of our hardware and software designs under open licenses,
we also hope to empower you to take as active a role in our collective
future as you wish!

Thank you for your interest in motor testing products from Altus Metrum.
Our first such product is EasyMotor, an in-flight motor data collection
board for hobby rockets. EasyMotor is a small circuit board that is meant
to log motor chamber pressure and rocket acceleration during flight. With
this data it's possible to determine whether a research motor is performing 
as expected. With additional information about masses and airframe drag, 
it is even possible to closely estimate complete motor performance.

With EasyMotor, the dilemma of “do I burn this on a test stand to learn more 
about how it actually works, or do I go fly it” is no more! You can fly your
motor and get real performance data about it too!

Because documentation is just as prone as software to contain “bugs”, and
can always be improved… If you have questions that aren't answered in this 
manual, or just need a little help figuring things out, we strongly suggest 
joining the Altus Metrum user email list, which you can do by visiting 
https://lists.gag.com/mailman/listinfo/altusmetrum.

