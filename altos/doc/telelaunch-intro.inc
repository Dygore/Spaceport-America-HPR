== Introduction and Overview

Welcome to the Altus Metrum community!  Our circuits and software reflect
our passion for both hobby rocketry and Free Software.  We hope their
capabilities and performance will delight you in every way, but by
releasing all of our hardware and software designs under open licenses,
we also hope to empower you to take as active a role in our collective
future as you wish!

Thank you for your interest in TeleLaunch, a wireless control system for
launching hobby rockets.  Each TeleLaunch system contains at least two units,
a launch control box (TeleLCO) and one or more launch initiation boxes 
(TeleFire).  In this manual, we hope to provide all the information required
to configure and successfully operate a TeleLaunch system.

Unlike other Altus Metrum products, that are usually provided as circuit
boards that the user must arrange to mount and wire up, all products in the
TeleLaunch system are sold as fully packaged, almost-ready-to-use units.  This
means that with only minimal one-time configuration of each unit, a TeleLaunch
system can be made ready for use very quickly.

Because documentation is just as prone as software to contain "bugs", and
can always be improved...  If you have questions that aren't answered in this 
manual, or just need a little help figuring things out, we strongly suggest 
joining the Altus Metrum user email list, which you can do by visiting 
https://lists.gag.com/mailman/listinfo/altusmetrum.

