== TeleGPS Quick Start Guide

	TeleGPS is designed to be easy to use. Requiring no external
	components, flying takes just a few steps.

	1. First, download and install the software from
	http://altusmetrum.org/AltOS. This will make sure that
	you have the right device drivers installed.

	2. Next, plug in the battery and USB cable and connect TeleGPS to
	your computer. This will charge the battery and allow you to
	configure the device.

	3. Start the TeleGPS application and set the callsign and frequency
	on your TeleGPS device; refer to <<_configure_device>> for instructions.

	4. Unplug TeleGPS when the battery charger light goes green. This
	will enable the radio and logging portions of the TeleGPS
	firmware.

	5. Connect TeleDongle to your computer and start TeleGPS or start
	AltosDroid on your android device and connect to TeleBT. Set the
	frequency to match the TeleGPS and you should be receiving telemetry.
