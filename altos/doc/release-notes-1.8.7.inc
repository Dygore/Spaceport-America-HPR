= Release Notes for Version 1.8.7
include::release-head.adoc[]
:doctype: article

	Version 1.8.7

	== AltOS

	* Include TeleMega v3.0 firmware
	
	== AltosUI, TeleGPS, MicroPeak

	* Poll for new devices while Device dialog is displayed

	* Wait for device to re-appear when flashing new firmware

	* Fetch correct TeleBT v4.0 RF calibration values from web
          site when reflashing.

	* Change gyro headings in .csv files from x/y/z to
          roll/pitch/yaw

	* Add documentation about Packet Link mode

	* Add documentation about forcing TeleMini RF parameters to
          known values.

	* Create a proxy server for Google Maps to re-enable map
          images

	* Fix Java version info in all distributed jar files so that
          applications will run with standard Mac OS X Java.

	* Replace JavaApplicationStub for Mac OS X so that
          applications will run with Oracle Java.

	
