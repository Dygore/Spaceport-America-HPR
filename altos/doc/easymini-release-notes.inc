[appendix]
== Release Notes
	:leveloffset: 2
	include::release-notes-1.9.10.adoc[]

	<<<<
	:leveloffset: 2
	include::release-notes-1.9.9.adoc[]

	<<<<
	:leveloffset: 2
	include::release-notes-1.9.8.adoc[]

	<<<<
	:leveloffset: 2
	include::release-notes-1.9.7.adoc[]

	<<<<
	:leveloffset: 2
	include::release-notes-1.9.6.adoc[]

	<<<<
	:leveloffset: 2
	include::release-notes-1.9.5.adoc[]

	<<<<
	:leveloffset: 2
	include::release-notes-1.9.4.adoc[]

	<<<<
	:leveloffset: 2
	include::release-notes-1.9.3.adoc[]

	<<<<
	:leveloffset: 2
	include::release-notes-1.9.1.adoc[]

	<<<<
	:leveloffset: 2
	include::release-notes-1.9.adoc[]

	<<<<
	:leveloffset: 2
	include::release-notes-1.8.7.adoc[]

	<<<<
	:leveloffset: 2
	include::release-notes-1.8.6.adoc[]

	<<<<
	:leveloffset: 2
	include::release-notes-1.8.5.adoc[]

	<<<<
	:leveloffset: 2
	include::release-notes-1.8.4.adoc[]

	<<<<
	:leveloffset: 2
	include::release-notes-1.8.3.adoc[]

	<<<<
	:leveloffset: 2
	include::release-notes-1.8.2.adoc[]

	<<<<
	:leveloffset: 2
	include::release-notes-1.8.1.adoc[]

	<<<<
	:leveloffset: 2
	include::release-notes-1.8.adoc[]

	<<<<
	:leveloffset: 2
	include::release-notes-1.7.adoc[]

	<<<<
	:leveloffset: 2
	include::release-notes-1.6.8.adoc[]

	<<<<
	:leveloffset: 2
	include::release-notes-1.6.5.adoc[]

	<<<<
	:leveloffset: 2
	include::release-notes-1.6.4.adoc[]

	:leveloffset: 2
	include::release-notes-1.6.3.adoc[]

	<<<<
	:leveloffset: 2
	include::release-notes-1.6.2.adoc[]

	:leveloffset: 0
