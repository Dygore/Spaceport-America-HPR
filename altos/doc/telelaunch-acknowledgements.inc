[dedication]
== Acknowledgments

	Our profound thanks to Terry Lee for major contributions to making 
	the TeleLaunch system something we could actually package and sell!

	Tripoli Colorado, Oregon Rocketry, New River Valley Rocketry, and 
	the National Association of Rocketry helped instigate this work, 
	and/or were early adopters of TeleLaunch.  We learned a lot working
	with each organization.  Thank you!

	Thanks also to our friends in the Kloudbusters, both for helping 
	us understand what it takes to run truly great large-scale launches, 
	and for providing some completely deserved, scathing feedback on 
	an early prototype of TeleLCO.

	Have fun using these products, and we hope to meet all of you
	out on a rocket flight line somewhere.

	[verse]
	Bdale Garbee, KB0G
	NAR #87103, TRA #12201

	[verse]
	Keith Packard, KD7SQG
	NAR #88757, TRA #12200
