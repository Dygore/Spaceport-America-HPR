== Introduction and Overview

	Welcome to the Altus Metrum community!  Our circuits and software reflect
	our passion for both hobby rocketry and Free Software.  We hope their
	capabilities and performance will delight you in every way, but by
	releasing all of our hardware and software designs under open licenses,
	we also hope to empower you to take as active a role in our collective
	future as you wish!

	Our goal is to include in this document all of the information required
	to successfully configure and use Altus Metrum products.  But 
	documentation is a lot like software in that it can contain "bugs",
	and can probably always be improved!  If you have questions that 
	aren't answered in this manual, or just need a little help figuring
	things out, we strongly suggest joining the Altus Metrum user email
	list, which you can do by visiting 
	https://lists.gag.com/mailman/listinfo/altusmetrum.  There's a lot
	of useful information in the mailing list archives!

	The first device created for our community was TeleMetrum, a dual
	deploy altimeter with fully integrated GPS and radio telemetry
	as standard features, and a “companion interface” that will
	support optional capabilities in the future. The later versions
	of TeleMetrum, v2 and newer, have all of the same features but with
	improved sensors and radio to offer increased performance.

	Our second device was TeleMini, a dual deploy altimeter with
	radio telemetry and radio direction finding. The first version
	of this device was only 13mm by 38mm (½ inch by 1½ inches) and
	could fit easily in an 18mm air-frame. The latest version, v3.0,
	includes a beeper, higher power radio, extended on-board
	flight logging and an improved barometric sensor.

	TeleMega is our most sophisticated device, including six pyro
	channels (four of which are fully programmable), integrated GPS,
	integrated gyroscopes for staging/air-start inhibit and high
	performance telemetry.

	EasyMini is a dual-deploy altimeter with logging and built-in
	USB data download.

	EasyMega is essentially a TeleMega board with the GPS receiver
	and telemetry transmitter removed. It offers the same 6 pyro
	channels and integrated gyroscopes for staging/air-start inhibit.

	TeleDongle v0.2 was our first ground station, providing a USB to RF
	interfaces for communicating with the altimeters. Combined with
	your choice of antenna and notebook computer, TeleDongle and our
	associated user interface software form a complete ground
	station capable of logging and displaying in-flight telemetry,
	aiding rocket recovery, then processing and archiving flight
	data for analysis and review. The latest version, TeleDongle
	v3, has all new electronics with a higher performance radio
	for improved range.

	For a slightly more portable ground station experience that also
	provides direct rocket recovery support, TeleBT offers flight
	monitoring and data logging using a  Bluetooth™ connection between
	the receiver and an Android device that has the AltosDroid
	application installed from the Google Play store.

	More products will be added to the Altus Metrum family over time, and
	we currently envision that this will be a single, comprehensive manual
	for the entire product family.
