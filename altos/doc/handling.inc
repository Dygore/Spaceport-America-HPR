[appendix]
== Handling Precautions

	All Altus Metrum products are sophisticated electronic devices.
	When handled gently and properly installed in an air-frame, they
	will deliver impressive results.  However, as with all electronic
	devices, there are some precautions you must take.

	[WARNING]
	The Lithium Polymer rechargeable batteries have an
	extraordinary power density.  This is great because we can fly with
	much less battery mass than if we used alkaline batteries or previous
	generation rechargeable batteries... but if they are punctured
	or their leads are allowed to short, they can and will release their
	energy very rapidly!
	Thus we recommend that you take some care when handling our batteries
	and consider giving them some extra protection in your air-frame.  We
	often wrap them in suitable scraps of closed-cell packing foam before
	strapping them down, for example.

	The barometric sensors used on all of our flight computers are
	sensitive to sunlight.  In normal mounting situations, the baro sensor
	and all of the other surface mount components
	are “down” towards whatever the underlying mounting surface is, so
	this is not normally a problem.  Please consider this when designing an
	installation in an air-frame with a see-through plastic payload bay.  It
	is particularly important to
	consider this with TeleMini v1.0, both because the baro sensor is on the
	“top” of the board, and because many model rockets with payload bays
	use clear plastic for the payload bay!  Replacing these with an opaque
	cardboard tube, painting them, or wrapping them with a layer of masking
	tape are all reasonable approaches to keep the sensor out of direct
	sunlight.

	The barometric sensor sampling port must be able to “breathe”,
	both by not being covered by foam or tape or other materials that might
	directly block the hole on the top of the sensor, and also by having a
	suitable static vent to outside air.

	As with all other rocketry electronics, Altus Metrum altimeters must
	be protected from exposure to corrosive motor exhaust and ejection
	charge gasses.

