[dedication]
== Acknowledgments

	Thanks to Bob Finch, W9YA, NAR 12965, TRA 12350 for writing “The
	Mere-Mortals Quick Start/Usage Guide to the Altus Metrum Starter
	Kit” which formed the basis of the original Getting Started chapter
	in this manual.  Bob was one of our first customers for a production
	TeleMetrum, and his continued enthusiasm and contributions
	are immensely gratifying and highly appreciated!

	And thanks to Anthony (AJ) Towns for major contributions including
	the AltosUI graphing and site map code and associated documentation.
	Free software means that our customers and friends can become our
	collaborators, and we certainly appreciate this level of
	contribution!

	Have fun using these products, and we hope to meet all of you
	out on the rocket flight line somewhere.

	[verse]
	Bdale Garbee, KB0G
	NAR #87103, TRA #12201

	[verse]
	Keith Packard, KD7SQG
	NAR #88757, TRA #12200
